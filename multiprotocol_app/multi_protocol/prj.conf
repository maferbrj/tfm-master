## CMakeLists.txt
```
# SPDX-License-Identifier: Apache-2.0

cmake_minimum_required(VERSION 3.20.0)
set(QEMU_EXTRA_FLAGS -s)

find_package(Zephyr REQUIRED HINTS $ENV{ZEPHYR_BASE})
project(mesh)

target_sources(app PRIVATE src/main.c)
target_sources(app PRIVATE src/fsm.c)
target_sources(app PRIVATE src/fsm_protocol_controller.c)
target_sources(app PRIVATE src/fsm_mesh.c)
target_sources(app PRIVATE src/model_handler.c)
target_sources(app PRIVATE src/fsm_thread.c)
target_sources(app PRIVATE src/coap_client.c)
target_sources(app PRIVATE src/coap_client_utils.c)



if (CONFIG_BUILD_WITH_TFM)
  target_include_directories(app PRIVATE
    $<TARGET_PROPERTY:tfm,TFM_BINARY_DIR>/install/interface/include
  )
endif()
```

## prj.conf
```kconfig
CONFIG_SYSTEM_WORKQUEUE_STACK_SIZE=2048

CONFIG_BT_SETTINGS=y
CONFIG_FLASH=y
CONFIG_FLASH_MAP=y
CONFIG_NVS=y
CONFIG_SETTINGS=y
CONFIG_HWINFO=y

CONFIG_BT=y
CONFIG_BT_L2CAP_TX_BUF_COUNT=5
CONFIG_BT_PERIPHERAL=y
CONFIG_BT_OBSERVER=y
CONFIG_BT_BROADCASTER=y
CONFIG_BT_COMPANY_ID=0x0059
#TODO: poner el id del sensor
CONFIG_BT_DEVICE_NAME="Sensor Server 2" #1....n

CONFIG_BT_CTLR_DUP_FILTER_LEN=0
CONFIG_BT_CTLR_LE_ENC=n
CONFIG_BT_CTLR_LE_PING=n
CONFIG_BT_DATA_LEN_UPDATE=n
CONFIG_BT_PHY_UPDATE=n
CONFIG_BT_CTLR_MIN_USED_CHAN=n
CONFIG_BT_CTLR_PRIVACY=n
CONFIG_BT_CTLR_CHAN_SEL_2=n

CONFIG_BT_MESH=y
CONFIG_BT_MESH_MODEL_EXTENSIONS=y
CONFIG_BT_MESH_RELAY=y
CONFIG_BT_MESH_FRIEND=y
CONFIG_BT_MESH_PB_GATT=y
CONFIG_BT_MESH_PB_ADV=y
CONFIG_BT_MESH_DK_PROV=y
CONFIG_BT_MESH_GATT_PROXY=y

CONFIG_BT_MESH_SUBNET_COUNT=2
CONFIG_BT_MESH_APP_KEY_COUNT=2
CONFIG_BT_MESH_MODEL_GROUP_COUNT=2
CONFIG_BT_MESH_LABEL_COUNT=3

CONFIG_OPENTHREAD=y


CONFIG_SMF=y
CONFIG_DK_LIBRARY=y
CONFIG_LOG=y
CONFIG_NETWORKING=y
CONFIG_NET_L2_OPENTHREAD=y
CONFIG_COAP=y
CONFIG_COAP_UTILS=y
CONFIG_COAP_CLIENT=y
CONFIG_NET_SOCKETS=y
CONFIG_NET_SOCKETS_POLL_MAX=4
CONFIG_OPENTHREAD_NETWORKKEY="00:11:22:33:44:55:66:77:88:99:aa:bb:cc:dd:ee:ff"
CONFIG_COUNTER=y
CONFIG_RTT_CONSOLE=y
CONFIG_I2C=y
CONFIG_NRFX_TWI0=y
CONFIG_NRFX_TWI1=y
CONFIG_RTC=y
CONFIG_NET_LOG=y
CONFIG_SENSOR=y
CONFIG_TEMP_NRF5=y
CONFIG_BT_MESH_SENSOR_SRV=y
CONFIG_BT_MESH_SENSOR_SRV_SENSORS_MAX=100
```

## src/main.c
```c
/* main.c - Application main entry point */

/*
 * Copyright (c) 2017 Intel Corporation
 *
 * SPDX-License-Identifier: Apache-2.0
 */

#include <zephyr/sys/printk.h>

#include <zephyr/settings/settings.h>
#include <zephyr/devicetree.h>
#include <zephyr/device.h>
#include <zephyr/drivers/gpio.h>

#include <zephyr/drivers/hwinfo.h>
#include <zephyr/sys/byteorder.h>

#include <zephyr/bluetooth/bluetooth.h>
#include <bluetooth/mesh/models.h>
#include <bluetooth/mesh/dk_prov.h>
#include <dk_buttons_and_leds.h>
#include <zephyr/net/openthread.h>
#include<bluetooth/mesh/sensor_types.h>
#include "../include/fsm_protocol_controller.h"
#include "../include/fsm_mesh.h"
#include "../include/fsm_thread.h"
#include "../include/coap_client_utils.h"
#include "../include/coap_client.h"
#include <openthread/platform/radio.h>
#include <zephyr/kernel.h>


#define PERIOD_MS 500 

void delay_until (uint32_t* p_due_date, uint32_t period)
{
	uint32_t now = k_uptime_get();
	*p_due_date += period; //sumamos el periodo (5ms) al instante incial
	uint32_t slack = *p_due_date - now; //calculamos cuanto falta para que pasen los 5ms
	if (slack <= period) { //si todavia falta tiempo para que cumplan los 5ms, esperamos ese tiempo
		k_msleep(slack);
	}
}

static void bt_ready(int err)
{
	if (err) {
		printk("Bluetooth init failed (err %d)\n", err);
		return;
	}

	printk("Bluetooth initialized\n");


	err = bt_mesh_init(bt_mesh_dk_prov_init(), model_handler_init());
	if (err) {
		printk("Initializing mesh failed (err %d)\n", err);
		return;
	}

	if (IS_ENABLED(CONFIG_SETTINGS)) {
		settings_load();
	}

	bt_mesh_prov_enable(BT_MESH_PROV_ADV | BT_MESH_PROV_GATT);

	printk("Mesh initialized\n");
}


int main(void)
{

	int err = -1;
	
	printk("Initializing...\n");

	
	err = bt_enable(bt_ready);
	if (err) {
		printk("Bluetooth init failed (err %d)\n", err);
	}

			
	
	
	fsm_t* fsm_protocol = fsm_new_fsm_protocol_controller(60000 * 5); //Tiempo de protocolo en ms
	fsm_t* fsm_mesh = fsm_new_fsm_mesh(fsm_protocol);
	fsm_t* fsm_thread  = fsm_new_fsm_thread(fsm_protocol);
	
    while (1) {
		uint32_t now = k_uptime_get();
		fsm_fire(fsm_protocol);
		fsm_fire(fsm_mesh);
		fsm_fire(fsm_thread);
		delay_until(&now, PERIOD_MS);
		
    }
	return 0;
}
```

## include/coap_client.h
```c
#ifndef COAP_CLIENT_H
#define COAP_CLIENT_H

#include "coap_client_utils.h"
#include "coap_server_client_interface.h"
#include <openthread/thread.h>
#include <openthread/instance.h>
/*
static hts221_t m_hts;
nrfx_twi_t m_twi;

static void twi_init(void);
static nrfx_err_t hts_init(void);
*/
int get_data(void);
bool thread_is_provisioned(otInstance *instance);

#endif
```

## include/fsm_mesh.h
```c
#ifndef FSM_MESH_H
#define FSM_MESH_H

#include "fsm.h"



//fsm_t fsm_new_fsm_mesh(fsm_t fsm_p);

fsm_t* fsm_new_fsm_mesh(fsm_t* fsm_p);
#endif
```

## include/fsm_protocol_controller.h
```c
#ifndef FSM_PROTOCOL_CONTROLLER_H
#define FSM_PROTOCOL_CONTROLLER_H

#include "fsm.h"
#include <stdint.h>


struct p_fsm_t;
typedef struct p_fsm_t p_fsm_t;


fsm_t* fsm_new_fsm_protocol_controller(uint32_t Tprotocol);
void set_flag_mesh (fsm_t* this);
void clear_flag_mesh (fsm_t* this);
int get_flag_mesh (fsm_t* this);
void set_flag_thread (fsm_t* this);
void clear_flag_thread (fsm_t* this);
int get_flag_thread (fsm_t* this);


#endif
```

## include/fsm_thread.h
```c
#ifndef FSM_THREAD_H
#define FSM_THREAD_H

#include "fsm.h"

#include <zephyr/drivers/gpio.h>
fsm_t* fsm_new_fsm_thread(fsm_t* fsm_p);
#endif
```

## src/coap_client.c
```c
/*
 * Copyright (c) 2020 Nordic Semiconductor ASA
 *
 * SPDX-License-Identifier: LicenseRef-Nordic-5-Clause
 */

#include <zephyr/kernel.h>
#include <dk_buttons_and_leds.h>
#include <zephyr/logging/log.h>
#include <ram_pwrdn.h>
#include <zephyr/device.h>
#include <zephyr/drivers/counter.h>
#include <zephyr/pm/device.h>
#include <zephyr/net/coap.h>
#include "../include/coap_client_utils.h"
#include <time.h>
#include <zephyr/sys/timeutil.h>
#include <zephyr/dt-bindings/clock/ast10x0_clock.h>
#include <zephyr/drivers/gpio.h>
#include "../include/coap_server_client_interface.h"
#include "../include/coap_client.h"


#define ID_SENSOR 1 


/*DIRECCIÓN MULTICAST
static struct sockaddr_in6 send_local_addr = {
	.sin6_family = AF_INET6,
	.sin6_port = htons(COAP_PORT),

	
	.sin6_addr.s6_addr = { 0xff, 0x03, 0x00, 0x00, 0x00, 0x00, 0x00, 0x00,
			       0x00, 0x00, 0x00, 0x00, 0x00, 0x00, 0x00, 0x01 },
	.sin6_scope_id = 0U
};
*/
//DIRECCIÓN UNICAST
static struct sockaddr_in6 send_local_addr = {
	.sin6_family = AF_INET6,
	.sin6_port = htons(COAP_PORT),
// example: fe80:0:0:0:4d8:2aa0:fb9e:fe37

	

	.sin6_addr.s6_addr = { 0xfe, 0x80, 0x00, 0x00, 0x00, 0x00, 0x00, 0x00,
			       0x04, 0xd8, 0x2a, 0xa0, 0xfb, 0x9e, 0xfe, 0x37},
	.sin6_scope_id = 0U
};

static const char *const sensor_option[] = { SENSOR_URI_PATH, NULL };

LOG_MODULE_REGISTER(coap_client);

#define OT_CONNECTION_LED DK_LED1
#define BLE_CONNECTION_LED DK_LED2
#define MTD_SED_LED DK_LED3


/** @brief Checks if ot node is provisioned by checking the role
 */
bool thread_is_provisioned(otInstance *instance){
	otDeviceRole role = otThreadGetDeviceRole(instance);
	LOG_INF("ROL:%d", role);
	return (role == OT_DEVICE_ROLE_CHILD ||
            role == OT_DEVICE_ROLE_ROUTER ||
            role == OT_DEVICE_ROLE_LEADER);
			
}

int get_temp(void){

	int temp[5] = {17, 18, 19, 20, 21};
	return temp[rand() % 5];
}

int get_hum(void){
	int hum[5] = {55, 56, 57, 58, 59};
	return hum[rand() % 5];
}
int get_data(void){
	int temp;
	int hum;
	char buffer[50];
	int err;
	if (IS_ENABLED(CONFIG_RAM_POWER_DOWN_LIBRARY)) {
		power_down_unused_ram();
	}
	temp = get_temp();
	hum = get_hum();
	memset(buffer, 0, sizeof(buffer));
	
	snprintf(buffer, sizeof(buffer),"ID:%d,t:%d,h:%d\n",ID_SENSOR, temp, hum);
	LOG_INF(" %s\n",buffer);

	err = coap_send_request(COAP_METHOD_PUT,
			  (const struct sockaddr *)&send_local_addr,
			  sensor_option, buffer,sizeof(buffer), NULL);
			  LOG_INF("Error: %d", err);


	return 0;
}
```

## src/coap_client_utils.c
```c
/*
 * Copyright (c) 2020 Nordic Semiconductor ASA
 *
 * SPDX-License-Identifier: LicenseRef-Nordic-5-Clause
 */

#include <zephyr/kernel.h>
#include "../include/coap_server_client_interface.h"
#include <net/coap_utils.h>
#include <zephyr/logging/log.h>
#include <zephyr/net/openthread.h>
#include <zephyr/net/socket.h>
#include <openthread/thread.h>
#include <openthread/instance.h>
#include "../include/coap_client_utils.h"

LOG_MODULE_REGISTER(coap_client_utils);


/* Options supported by the server */
static const char *const sensor_option[] = { SENSOR_URI_PATH, NULL };
static const char *const provisioning_option[] = { PROVISIONING_URI_PATH,
						   NULL };

/* Thread multicast mesh local address */
static struct sockaddr_in6 send_local_addr = {
	.sin6_family = AF_INET6,
	.sin6_port = htons(COAP_PORT),
	.sin6_addr.s6_addr = { 0xff, 0x03, 0x00, 0x00, 0x00, 0x00, 0x00, 0x00,
			       0x00, 0x00, 0x00, 0x00, 0x00, 0x00, 0x00, 0x01 },
	.sin6_scope_id = 0U
};

/* Variable for storing server address acquiring in provisioning handshake */
static char unique_local_addr_str[INET6_ADDRSTRLEN];
static struct sockaddr_in6 unique_local_addr = {
	.sin6_family = AF_INET6,
	.sin6_port = htons(COAP_PORT),
	.sin6_addr.s6_addr = {0, },
	.sin6_scope_id = 0U
};

otInstance* coap_client_utils_init(void)
{
	otInstance *instance;
	instance = otInstanceInitSingle();	
	coap_init(AF_INET6, NULL);
	openthread_start(openthread_get_default_context());
	return instance;
}
```

## src/fsm_mesh.c
```c
/*  - Application main entry point */

/*
 * Copyright (c) 2017 Intel Corporation
 *
 * SPDX-License-Identifier: Apache-2.0
 */
#include <zephyr/sys/printk.h>
#include <zephyr/settings/settings.h>
#include <zephyr/devicetree.h>
#include <zephyr/device.h>
#include <zephyr/drivers/gpio.h>
#include <zephyr/drivers/hwinfo.h>
#include <zephyr/sys/byteorder.h>
#include "../include/fsm.h"
#include <zephyr/bluetooth/bluetooth.h>
#include <zephyr/bluetooth/mesh.h>
#include <zephyr/kernel.h>
#include "../include/fsm_mesh.h"
#include "../include/fsm_protocol_controller.h"
#include <zephyr/logging/log.h>
#include "../include/model_handler.h"
#include <zephyr/drivers/gpio.h>

LOG_MODULE_REGISTER(fsm_mesh);
static int flag_provision = 0;

static const struct gpio_dt_spec *gpio0_3 ;
//-----para latencia------
#include <zephyr/drivers/gpio.h>
//#define LED0_NODE DT_ALIAS(led0)
//static const struct gpio_dt_spec gpio0_3 = GPIO_DT_SPEC_GET(LED0_NODE, gpios);
//-------------------

#define TIMEOUT_MS (5 * 1000 ) //Periodo de envío de datos

struct k_timer timer_mesh;
static int flag_send_mesh = 0;

struct m_fsm_t{
	fsm_t fsm;
    fsm_t* fsm_p;
};
typedef struct m_fsm_t m_fsm_t;
void setTimerFlag_mesh(struct k_timer *my_timer)
{
        flag_send_mesh = 1;
       
}

/* List of check functions */
 static int check_mesh(fsm_t* this)
{   
    m_fsm_t* m_fsm = (m_fsm_t*) this;
    int f_mesh = get_flag_mesh(m_fsm->fsm_p);
    return f_mesh;
}
 static int check_reading_mesh(fsm_t* this){
	m_fsm_t* m_fsm = (m_fsm_t*) this;
    int f_mesh = get_flag_mesh(m_fsm->fsm_p);
    LOG_INF("State : CHECK TIMER flag send mesh: %d", flag_send_mesh); 
    return (f_mesh && flag_send_mesh);
      
 }
static int check_no_mesh(fsm_t* this)
{
	m_fsm_t* m_fsm = (m_fsm_t*) this;
    return (!get_flag_mesh(m_fsm->fsm_p));
}

 /*Funciones de acción*/
static void init_mesh(fsm_t* this)
{       
	LOG_INF("INICIALIZANDO TIMER MESH\n");
    k_timer_init(&timer_mesh, setTimerFlag_mesh, NULL);
    k_timer_start(&timer_mesh, K_MSEC(TIMEOUT_MS), K_MSEC(TIMEOUT_MS));
    //latencia:
    //gpio_pin_configure_dt(&led, GPIO_OUTPUT_ACTIVE);
	//gpio_pin_set(led.port,led.pin,0);
    
}


static void send_data_mesh(fsm_t* this)
{
        flag_send_mesh = 0;
        //gpio_pin_set(gpio0_3->port,gpio0_3->pin,1);
        send_data();
        //gpio_pin_set(gpio0_3->port,gpio0_3->pin,0);
        LOG_INF("SENDING DATA MESH");

		
}
static void stop_mesh(fsm_t* this){
    k_timer_stop(&timer_mesh);
	flag_send_mesh = 0;
	LOG_INF("Disableling mesh\n");
}
static enum STATE{
		OFF,
        READ_MESH
};

fsm_t* fsm_new_fsm_mesh(fsm_t* fsm_p){
        static fsm_trans_t tt[] = {
                {OFF, check_mesh, READ_MESH, init_mesh},
				{READ_MESH, check_reading_mesh, READ_MESH, send_data_mesh},
                {READ_MESH, check_no_mesh, OFF, stop_mesh},
				{-1, NULL, -1, NULL},
        };
m_fsm_t* lm_fsm = (m_fsm_t*) malloc (sizeof (m_fsm_t));
fsm_init ((fsm_t*) lm_fsm, tt);
lm_fsm->fsm_p = fsm_p;
return (fsm_t*)lm_fsm;

	
}
```

## src/fsm_protocol_controller.c
```c
#include <zephyr/sys/printk.h>
#include <zephyr/settings/settings.h>
#include <zephyr/devicetree.h>
#include <zephyr/device.h>
#include <zephyr/drivers/gpio.h>
#include <zephyr/drivers/hwinfo.h>
#include <zephyr/sys/byteorder.h>

#include "../include/fsm.h"
#include <zephyr/bluetooth/bluetooth.h>
#include <zephyr/bluetooth/mesh.h>
#include <bluetooth/mesh/dk_prov.h>

#include <zephyr/kernel.h>
#include "../include/fsm_protocol_controller.h"
#include <zephyr/logging/log.h>
#include <zephyr/net/openthread.h>
#include <openthread/thread.h>
#include <openthread/coap.h>
#include <openthread/coap_secure.h>
#include "../include/coap_client.h"
#include "../include/model_handler.h"
#include "../include/main.h"
LOG_MODULE_REGISTER(fsm_protocol_controller);

struct openthread_context *contexto;

struct p_fsm_t{
	fsm_t fsm;
    int flag_mesh;
    int flag_thread;
    uint32_t next;
    uint32_t Tprotocol;
};
typedef struct p_fsm_t p_fsm_t;

/*API */
int get_flag_mesh(fsm_t* this){
    p_fsm_t* p_fsm = (p_fsm_t*) this;
    int ret = p_fsm->flag_mesh;
    return ret;
}
void set_flag_mesh(fsm_t* this){
    p_fsm_t* p_fsm = (p_fsm_t*) this;
    p_fsm->flag_mesh = 1;
 }
void clear_flag_mesh(fsm_t* this){
    p_fsm_t* p_fsm = (p_fsm_t*) this;
    p_fsm->flag_mesh = 0;
 }

int get_flag_thread(fsm_t* this){
    p_fsm_t* p_fsm = (p_fsm_t*) this;
    int ret = p_fsm->flag_thread;
    return ret;
}
void set_flag_thread(fsm_t* this){
    p_fsm_t* p_fsm = (p_fsm_t*) this;
    p_fsm->flag_thread = 1;
 }
void clear_flag_thread(fsm_t* this){
    p_fsm_t* p_fsm = (p_fsm_t*) this;
    p_fsm->flag_thread = 0;
 }

//-----------------------------------------------------

/*List of check functions*/
static int always_check(fsm_t* this)
{
    return 1;
}
static int check_tim_protocol(fsm_t* this)
{   
    p_fsm_t* p_fsm = (p_fsm_t*) this;
    int tout = k_uptime_get() >= p_fsm->next;
    LOG_INF("TIMER PROTOCOL: %d MESH:%d THREAD:%d \n", tout, p_fsm->flag_mesh, p_fsm->flag_thread);
    return (tout);
}

static int check_mesh_prov(fsm_t* this)
{
    int prov = bt_mesh_is_provisioned();
    LOG_INF("PROVISIONADO MESH: %d", prov);
    return prov;
}

static int check_thread_prov(fsm_t* this)
{
    LOG_INF ("PROVISIONADO THREAD: %d", thread_is_provisioned(contexto->instance));
    return thread_is_provisioned(contexto->instance);
}

/*List of action functions*/
static void configure_mesh(fsm_t* this)
{
	LOG_INF("CONFIGURE MESH\n");
}

static void wait_prov_mesh(fsm_t* this)
{
        k_sleep(K_SECONDS(30));
}

static void configure_thread(fsm_t* this)
{
    int sus = bt_mesh_suspend();
    p_fsm_t* p_fsm = (p_fsm_t*) this;
    clear_flag_mesh(this);
    clear_flag_thread(this);   
    contexto = openthread_get_default_context();
	contexto->instance = coap_client_utils_init();
}
 static void init_multiprotocol(fsm_t* this)
 {
    p_fsm_t* p_fsm = (p_fsm_t*) this; 
    p_fsm->next = k_uptime_get() + (p_fsm->Tprotocol);
    bt_mesh_resume();
    set_flag_mesh(this);
    clear_flag_thread(this);
    LOG_INF("EMPIEZA MULTIPROTOCOLO EN MESH");

 }

static void enable_thread(fsm_t* this)
{
    p_fsm_t* p_fsm = (p_fsm_t*) this; 
    p_fsm->next = (p_fsm->next) + (p_fsm->Tprotocol);
    LOG_INF("Enable Thread\n");
    clear_flag_mesh(this);
    k_msleep(1000);
    set_flag_thread(this);
 
}

static void enable_mesh(fsm_t* this){
    p_fsm_t* p_fsm = (p_fsm_t*) this;
    p_fsm->next =(p_fsm->next) + (p_fsm->Tprotocol);
    int sus = -1;
    LOG_INF("Enable Mesh\n");
    clear_flag_thread(this);
    LOG_INF("deshabilitando Thread");
    otError err = otThreadSetEnabled(contexto->instance, false);
    if (err != OT_ERROR_NONE) {
        LOG_INF("Error deteniendo Thread: %d", err);
    }
    k_msleep(100);
    LOG_INF("Habilitando Mesh");
    bt_mesh_resume();
    k_msleep(1000);
    LOG_INF("COMPLETE MESH ENABLE()");
   LOG_INF("BT MESH RESUME: %d", sus);

}
static enum STATE{
        CONF_BT,
        WAIT,
        CONF_OT,
        OT,
        MESH
};

fsm_t* fsm_new_fsm_protocol_controller(uint32_t protocolT){
        static fsm_trans_t tt[] = {
                {CONF_BT, check_mesh_prov, WAIT, wait_prov_mesh}, 
                {WAIT, always_check, MESH, init_multiprotocol},
                {MESH, check_tim_protocol, CONF_OT, configure_thread},
                {CONF_OT, check_thread_prov, OT, enable_thread}, 
                {OT, check_tim_protocol, MESH, enable_mesh},                
                {-1, NULL, -1, NULL},
        };
    p_fsm_t* lp_fsm = (p_fsm_t*) malloc (sizeof (p_fsm_t));
   fsm_init ((fsm_t*) lp_fsm, tt);
   lp_fsm->Tprotocol = protocolT;
   lp_fsm->next = k_uptime_get()+protocolT;
   clear_flag_mesh((fsm_t*) lp_fsm);
   clear_flag_thread((fsm_t*) lp_fsm);
   return (fsm_t*) lp_fsm;
}
```

## src/fsm_thread.c
```c
#include <zephyr/kernel.h>
#include <dk_buttons_and_leds.h>
#include <zephyr/pm/device.h>
#include <zephyr/net/coap.h>
#include <zephyr/logging/log.h>
#include <ram_pwrdn.h>
#include <zephyr/device.h>
#include <zephyr/drivers/counter.h>
#include "../include/fsm.h"
#include "../include/fsm_protocol_controller.h"
#include "../include/fsm_thread.h"
#include "../include/coap_client.h"
#include <zephyr/drivers/gpio.h>
#include <dk_buttons_and_leds.h>

LOG_MODULE_REGISTER(fsm_thread);

//static const struct gpio_dt_spec *gpio0_3 ;

#define TIMEOUT_MS (5 * 1000) 
char buffer[50];



struct k_timer timer_thread;
static int flag_send_thread = 0;

struct t_fsm_t{
	fsm_t fsm;
    fsm_t* fsm_p;
};
typedef struct t_fsm_t t_fsm_t;
void setTimerFlag_thread(struct k_timer *my_timer)
{
        flag_send_thread = 1;
        
}
 /*Check functions*/
static int check_thread(fsm_t* this)
{   
    t_fsm_t* t_fsm = (t_fsm_t*) this;
    int f_thread = get_flag_thread(t_fsm->fsm_p);
    return f_thread;
}

static int check_reading_thread(fsm_t* this)
{
    t_fsm_t* t_fsm = (t_fsm_t*) this;
    return (get_flag_thread(t_fsm->fsm_p) && flag_send_thread);  
}
static int check_no_thread(fsm_t* this){
    
    t_fsm_t* t_fsm = (t_fsm_t*) this;
    return (!get_flag_thread(t_fsm->fsm_p));
}

/*Action functions*/
static void init_thread(fsm_t* this)
{   
	LOG_INF("Inicializando TIMER THREAD");
    k_timer_init(&timer_thread, setTimerFlag_thread, NULL);
    k_timer_start(&timer_thread, K_MSEC(TIMEOUT_MS), K_MSEC(TIMEOUT_MS));  
    //gpio_pin_configure_dt(&led, GPIO_OUTPUT_ACTIVE);
	//gpio_pin_set(led.port,led.pin,0); 

}

static void send_data_thread(fsm_t* this){
    flag_send_thread = 0;
    LOG_INF("Sending data thread");
    //gpio_pin_set(gpio0_3->port,gpio0_3->pin,1);
    get_data();
    //gpio_pin_set(gpio0_3->port,gpio0_3->pin,0);  
}
static void stop_thread(fsm_t* this){
    k_timer_stop(&timer_thread);
    flag_send_thread = 0;
    k_sleep(K_SECONDS(30));
    LOG_INF("Disableling thread\n");
}

static enum STATE{
        OFF,
        READ_THREAD
};

fsm_t* fsm_new_fsm_thread(fsm_t* fsm_p){
        static fsm_trans_t tt[] = {
                {OFF, check_thread, READ_THREAD, init_thread},
                {READ_THREAD, check_reading_thread, READ_THREAD, send_data_thread},
                {READ_THREAD, check_no_thread, OFF, stop_thread},
                {-1, NULL, -1, NULL},
        };
t_fsm_t* lt_fsm = (t_fsm_t*) malloc (sizeof (t_fsm_t));
fsm_init ((fsm_t*) lt_fsm, tt);
lt_fsm->fsm_p = fsm_p;
return (fsm_t*)lt_fsm;

}
```

## src/model_handler.c
```c
/*
 * Copyright (c) 2020 Nordic Semiconductor ASA
 *
 * SPDX-License-Identifier: LicenseRef-Nordic-5-Clause
 */

#include <zephyr/device.h>
#include <zephyr/devicetree.h>
#include <zephyr/bluetooth/bluetooth.h>
#include <zephyr/drivers/sensor.h>
#include <bluetooth/mesh/models.h>
#include <bluetooth/mesh/sensor_types.h>
#include <dk_buttons_and_leds.h>
#include <float.h>
#include "../include/model_handler.h"
#include <bluetooth/mesh/dk_prov.h>

#define SENSOR_ID 1
static struct bt_mesh_sensor temperature_indoor_sensor = {
	.type = &bt_mesh_sensor_present_indoor_amb_temp,
};
static struct bt_mesh_sensor *const temperature_sensor[] = {
	&temperature_indoor_sensor,
};
static struct bt_mesh_sensor_srv temperaturita_sensor_srv =
	BT_MESH_SENSOR_SRV_INIT(temperature_sensor, ARRAY_SIZE(temperature_sensor));



static struct bt_mesh_sensor humidity_indoor_sensor_level = {
	.type = &bt_mesh_sensor_present_indoor_relative_humidity,
};
static struct bt_mesh_sensor *const humidity_sensor[] = {
	&humidity_indoor_sensor_level,
};
static struct bt_mesh_sensor_srv humidity_sensor_srv =
	BT_MESH_SENSOR_SRV_INIT(humidity_sensor, ARRAY_SIZE(humidity_sensor));


static struct bt_mesh_elem elements[] = {
	//humidity
	BT_MESH_ELEM(1,
		     BT_MESH_MODEL_LIST(BT_MESH_MODEL_CFG_SRV,
								BT_MESH_MODEL_SENSOR_SRV(&humidity_sensor_srv)),
		     					BT_MESH_MODEL_NONE),
	//temperature
	BT_MESH_ELEM(2,
		     BT_MESH_MODEL_LIST(BT_MESH_MODEL_SENSOR_SRV(&temperaturita_sensor_srv)),
		     BT_MESH_MODEL_NONE),
};

static const struct bt_mesh_comp comp = {
	.cid = CONFIG_BT_COMPANY_ID,
	.elem = elements,
	.elem_count = ARRAY_SIZE(elements),
};

const struct bt_mesh_comp *model_handler_init(void)
{
	return &comp;
}

struct sensor_value get_temperature(void){
	struct sensor_value temp;
	sensor_value_from_double(&temp, (20+SENSOR_ID));
	return temp;
}

struct sensor_value get_humidity(void){
	struct sensor_value hum;
	double rand_hum[5] = {0.5, 0.51, 0.52, 0.53, 0.54};
	int i = rand() % 5;
	sensor_value_from_double(&hum, rand_hum[i]);
	return hum;
}

int send_data(void){
	int err;
	struct sensor_value temp;
	struct sensor_value hum;

	//---latency
	//sensor_value_from_double(&temp, 1.0);
	//sensor_value_from_double(&hum, 1.0);
	
	//----------------------------
	temp = get_temperature();
	hum = get_humidity();
	//humidity
	err = bt_mesh_sensor_srv_pub(&humidity_sensor_srv, NULL,&humidity_indoor_sensor_level, &hum);
	if (err) {
		printk("Error publishing humidity(%d)\n", err);
	}
	
	//temperature
	err = bt_mesh_sensor_srv_pub(&temperaturita_sensor_srv, NULL, &temperature_indoor_sensor, &temp);
	if (err) {
		printk("Error publishing temperature(%d)\n", err);
	}
	return err;
}
```
