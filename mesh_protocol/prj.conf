## CMakeLists.txt
```
# SPDX-License-Identifier: Apache-2.0

cmake_minimum_required(VERSION 3.20.0)
set(QEMU_EXTRA_FLAGS -s)

find_package(Zephyr REQUIRED HINTS $ENV{ZEPHYR_BASE})
project(mesh)

target_sources(app PRIVATE src/main.c)
target_sources(app PRIVATE src/fsm.c)
target_sources(app PRIVATE src/fsm_protocol_controller.c)
target_sources(app PRIVATE src/fsm_mesh.c)
target_sources(app PRIVATE src/model_handler.c)
target_sources(app PRIVATE src/fsm_thread.c)
target_sources(app PRIVATE src/coap_client.c)
target_sources(app PRIVATE src/coap_client_utils.c)



if (CONFIG_BUILD_WITH_TFM)
  target_include_directories(app PRIVATE
    $<TARGET_PROPERTY:tfm,TFM_BINARY_DIR>/install/interface/include
  )
endif()
```

## sample.yaml
```
sample:
  name: Bluetooth Mesh
tests:
  sample.bluetooth.mesh:
    harness: bluetooth
    platform_allow:
      - bbc_microbit
      - qemu_x86
      - nrf52840dk_nrf52840
      - nrf5340dk_nrf5340_cpuapp_ns
    integration_platforms:
      - qemu_x86
    tags: bluetooth
```

## prj.conf
```kconfig
CONFIG_SYSTEM_WORKQUEUE_STACK_SIZE=2048

CONFIG_BT_SETTINGS=y
CONFIG_FLASH=y
CONFIG_FLASH_MAP=y
CONFIG_NVS=y
CONFIG_SETTINGS=y
CONFIG_HWINFO=y

CONFIG_BT=y
CONFIG_BT_L2CAP_TX_BUF_COUNT=5
CONFIG_BT_PERIPHERAL=y
CONFIG_BT_OBSERVER=y
CONFIG_BT_BROADCASTER=y
CONFIG_BT_COMPANY_ID=0x0059
#TODO: poner el id del sensor
CONFIG_BT_DEVICE_NAME="Sensor Server 2" #1....n

CONFIG_BT_CTLR_DUP_FILTER_LEN=0
CONFIG_BT_CTLR_LE_ENC=n
CONFIG_BT_CTLR_LE_PING=n
CONFIG_BT_DATA_LEN_UPDATE=n
CONFIG_BT_PHY_UPDATE=n
CONFIG_BT_CTLR_MIN_USED_CHAN=n
CONFIG_BT_CTLR_PRIVACY=n
CONFIG_BT_CTLR_CHAN_SEL_2=n

CONFIG_BT_MESH=y
CONFIG_BT_MESH_MODEL_EXTENSIONS=y
CONFIG_BT_MESH_RELAY=y
CONFIG_BT_MESH_FRIEND=y
CONFIG_BT_MESH_PB_GATT=y
CONFIG_BT_MESH_PB_ADV=y
CONFIG_BT_MESH_DK_PROV=y
CONFIG_BT_MESH_GATT_PROXY=y

CONFIG_BT_MESH_SUBNET_COUNT=2
CONFIG_BT_MESH_APP_KEY_COUNT=2
CONFIG_BT_MESH_MODEL_GROUP_COUNT=2
CONFIG_BT_MESH_LABEL_COUNT=3

CONFIG_OPENTHREAD=y


CONFIG_SMF=y
CONFIG_DK_LIBRARY=y
CONFIG_LOG=y
CONFIG_NETWORKING=y
CONFIG_NET_L2_OPENTHREAD=y
CONFIG_COAP=y
CONFIG_COAP_UTILS=y
CONFIG_COAP_CLIENT=y
CONFIG_NET_SOCKETS=y
CONFIG_NET_SOCKETS_POLL_MAX=4
CONFIG_OPENTHREAD_NETWORKKEY="00:11:22:33:44:55:66:77:88:99:aa:bb:cc:dd:ee:ff"
CONFIG_COUNTER=y
CONFIG_RTT_CONSOLE=y
CONFIG_I2C=y
CONFIG_NRFX_TWI0=y
CONFIG_NRFX_TWI1=y
CONFIG_RTC=y
CONFIG_NET_LOG=y
CONFIG_SENSOR=y
CONFIG_TEMP_NRF5=y
CONFIG_BT_MESH_SENSOR_SRV=y
CONFIG_BT_MESH_SENSOR_SRV_SENSORS_MAX=100
```

## microbit_gatt.conf
```kconfig
#CONFIG_INIT_STACKS=y
CONFIG_ISR_STACK_SIZE=768
CONFIG_MAIN_STACK_SIZE=320
CONFIG_IDLE_STACK_SIZE=128
CONFIG_DISPLAY=y
CONFIG_MICROBIT_DISPLAY=y
CONFIG_GPIO=y

CONFIG_BT_PERIPHERAL=y
CONFIG_BT_MESH_GATT_PROXY=y
CONFIG_BT_MESH_PB_GATT=y
CONFIG_BT_MESH_PB_ADV=n

CONFIG_BT=y
CONFIG_BT_DEVICE_NAME="Zephyr Mesh"
CONFIG_BT_RX_STACK_SIZE=1400
CONFIG_BT_L2CAP_TX_BUF_COUNT=5
CONFIG_BT_EXT_ADV=n

CONFIG_BT_CTLR_DUP_FILTER_LEN=0
CONFIG_BT_OBSERVER=y
CONFIG_BT_BROADCASTER=y

CONFIG_BT_CTLR_LE_ENC=n
CONFIG_BT_CTLR_LE_PING=n
CONFIG_BT_DATA_LEN_UPDATE=n
CONFIG_BT_PHY_UPDATE=n
CONFIG_BT_CTLR_CHAN_SEL_2=n
CONFIG_BT_CTLR_MIN_USED_CHAN=n
CONFIG_BT_CTLR_ADV_EXT=n
CONFIG_BT_CTLR_PRIVACY=n

CONFIG_BT_MESH=y
CONFIG_BT_MESH_ADV_BUF_COUNT=3
CONFIG_BT_MESH_SEG_BUFS=6
CONFIG_BT_MESH_RELAY=y
CONFIG_BT_MESH_MSG_CACHE_SIZE=2

#CONFIG_BT_MESH_LOW_POWER=y

#CONFIG_BT_MESH_SELF_TEST=y
#CONFIG_BT_MESH_IV_UPDATE_TEST=y

CONFIG_BT_MESH_SUBNET_COUNT=1
CONFIG_BT_MESH_APP_KEY_COUNT=1
CONFIG_BT_MESH_MODEL_GROUP_COUNT=1
CONFIG_BT_MESH_LABEL_COUNT=0

#CONFIG_UART_CONSOLE=n
#CONFIG_BT_DEBUG_MONITOR_UART=y
#CONFIG_BT_DEBUG_LOG=y

#CONFIG_BT_MESH_LOG_LEVEL_DBG=y
#CONFIG_BT_MESH_NET_LOG_LEVEL_DBG=y
#CONFIG_BT_MESH_PROXY_LOG_LEVEL_DBG=y
#CONFIG_BT_MESH_TRANS_LOG_LEVEL_DBG=y
#CONFIG_BT_MESH_LOG_LEVEL_DBG=y
#CONFIG_BT_MESH_BEACON_LOG_LEVEL_DBG=y
#CONFIG_BT_MESH_CRYPTO_LOG_LEVEL_DBG=y
#CONFIG_BT_MESH_ADV_LOG_LEVEL_DBG=y
#CONFIG_BT_MESH_ACCESS_LOG_LEVEL_DBG=y
```

## boards/bbc_microbit.conf
```kconfig
CONFIG_INIT_STACKS=y
CONFIG_ISR_STACK_SIZE=768
CONFIG_MAIN_STACK_SIZE=512
CONFIG_DISPLAY=y
CONFIG_MICROBIT_DISPLAY=y
CONFIG_SYSTEM_WORKQUEUE_STACK_SIZE=1024
CONFIG_MICROBIT_DISPLAY_STR_MAX=5
CONFIG_GPIO=y

CONFIG_PM=n

CONFIG_BT_PERIPHERAL=n
CONFIG_BT_EXT_ADV=n
CONFIG_BT_RX_STACK_SIZE=1100
CONFIG_BT_BUF_EVT_RX_COUNT=3
CONFIG_BT_BUF_ACL_RX_COUNT=3
CONFIG_BT_BUF_EVT_DISCARDABLE_COUNT=3

CONFIG_BT_CTLR_ADV_EXT=n

CONFIG_BT_MESH_ADV_BUF_COUNT=3
CONFIG_BT_MESH_SEG_BUFS=3
CONFIG_BT_MESH_RELAY=n
CONFIG_BT_MESH_LOOPBACK_BUFS=1

CONFIG_BT_MESH_PB_GATT=n
CONFIG_BT_MESH_GATT_PROXY=n
CONFIG_BT_MESH_MODEL_EXTENSIONS=n
CONFIG_BT_MESH_FRIEND=n

CONFIG_BT_MESH_SUBNET_COUNT=1
CONFIG_BT_MESH_APP_KEY_COUNT=1
CONFIG_BT_MESH_MODEL_GROUP_COUNT=1
CONFIG_BT_MESH_LABEL_COUNT=0
```

## boards/nrf5340dk_nrf5340_cpuapp_ns.conf
```kconfig
# Known issue: non secure platforms do not work with settings subsystem.
CONFIG_SETTINGS=n
CONFIG_BT_SETTINGS=n
```

## src/main.c
```c
/* main.c - Application main entry point */

/*
 * Copyright (c) 2017 Intel Corporation
 *
 * SPDX-License-Identifier: Apache-2.0
 */

#include <zephyr/sys/printk.h>

#include <zephyr/settings/settings.h>
#include <zephyr/devicetree.h>
#include <zephyr/device.h>
#include <zephyr/drivers/gpio.h>
#include <zephyr/drivers/hwinfo.h>
#include <zephyr/sys/byteorder.h>

#include <zephyr/bluetooth/bluetooth.h>
///#include <zephyr/bluetooth/mesh.h>
#include <bluetooth/mesh/models.h>
#include <bluetooth/mesh/dk_prov.h>
#include <dk_buttons_and_leds.h>
#include <zephyr/net/openthread.h>
#include<bluetooth/mesh/sensor_types.h>
#include "../include/fsm_protocol_controller.h"
#include "../include/fsm_mesh.h"
#include "../include/fsm_thread.h"
#include "../include/coap_client_utils.h"
#include "../include/coap_client.h"
#include <openthread/platform/radio.h>
#include <zephyr/kernel.h>
//#include "../include/model_handler.h"

#define PERIOD_MS 500 //
//otInstance *instancia;
//extern struct openthread_context *contexto;

void delay_until (uint32_t* p_due_date, uint32_t period)
{
	uint32_t now = k_uptime_get();
	*p_due_date += period; //sumamos el periodo (5ms) al instante incial
	uint32_t slack = *p_due_date - now; //calculamos cuanto falta para que pasen los 5ms
	if (slack <= period) { //si todavia falta tiempo para que cumplan los 5ms, esperamos ese tiempo
		k_msleep(slack);
	}
}

static void bt_ready(int err)
{
	if (err) {
		printk("Bluetooth init failed (err %d)\n", err);
		return;
	}

	printk("Bluetooth initialized\n");


	err = bt_mesh_init(bt_mesh_dk_prov_init(), model_handler_init());
	if (err) {
		printk("Initializing mesh failed (err %d)\n", err);
		return;
	}

	if (IS_ENABLED(CONFIG_SETTINGS)) {
		settings_load();
	}

	bt_mesh_prov_enable(BT_MESH_PROV_ADV | BT_MESH_PROV_GATT);

	printk("Mesh initialized\n");
}


int main(void)
{

	int err = -1;
	
	printk("Initializing...\n");

	
	err = bt_enable(bt_ready);
	//bt_mesh_suspend(); 
	if (err) {
		printk("Bluetooth init failed (err %d)\n", err);
	}
	
	
	//-----para latencia-------
	//gpio_pin_configure_dt(&gpio0_3,GPIO_OUTPUT_ACTIVE);
	//gpio_pin_set(gpio0_3.port,gpio0_3.pin,0);
	//--------------------------			
	
	
	
	fsm_t* fsm_protocol = fsm_new_fsm_protocol_controller(60000);
	fsm_t* fsm_mesh = fsm_new_fsm_mesh(fsm_protocol);
	fsm_t* fsm_thread  = fsm_new_fsm_thread(fsm_protocol);
	
    while (1) {
        // Aquí puedes agregar otras tareas o poner el sistema en modo de ahorro de energía
        //k_sleep(K_FOREVER); // Pone el sistema a dormir hasta que se active otro evento
		uint32_t now = k_uptime_get();
		fsm_fire(fsm_protocol);
		fsm_fire(fsm_mesh);
		fsm_fire(fsm_thread);
		
		
		delay_until(&now, PERIOD_MS);
		
    }
	return 0;
}
```

## include/coap_client.h
```c
#ifndef COAP_CLIENT_H
#define COAP_CLIENT_H

#include "coap_client_utils.h"
#include "coap_server_client_interface.h"
#include "nrfx_twi.h"
#include "hts221.h"
#include <zephyr/drivers/i2c.h>
#include <openthread/thread.h>
#include <openthread/instance.h>
/*
static hts221_t m_hts;
nrfx_twi_t m_twi;

static void twi_init(void);
static nrfx_err_t hts_init(void);
*/
int get_data(void);
bool thread_is_provisioned(otInstance *instance);

#endif
```

## include/coap_client_utils.h
```c
/**
 * @file
 * @defgroup coap_client_utils API for coap_client_* samples
 * @{
 */

/*
 * Copyright (c) 2020 Nordic Semiconductor ASA
 *
 * SPDX-License-Identifier: LicenseRef-Nordic-5-Clause
 */

#ifndef __COAP_CLIENT_UTILS_H__
#define __COAP_CLIENT_UTILS_H__
#include <openthread/instance.h>
#include <openthread/thread.h>

/** @brief Type indicates function called when OpenThread connection
 *         is established.
 *
 * @param[in] item pointer to work item.
 */
typedef void (*ot_connection_cb_t)(struct k_work *item);

/** @brief Type indicates function called when OpenThread connection is ended.
 *
 * @param[in] item pointer to work item.
 */
typedef void (*ot_disconnection_cb_t)(struct k_work *item);

/** @brief Type indicates function called when the MTD modes are toggled.
 *
 * @param[in] val 1 if the MTD is in MED mode
 *                0 if the MTD is in SED mode
 */
typedef void (*mtd_mode_toggle_cb_t)(uint32_t val);

/** @brief Initialize CoAP client utilities.
 */
otInstance* coap_client_utils_init(void);
//void coap_client_utils_init(void);

/** @brief Toggle light on the CoAP server node.
 *
 * @note The CoAP server should be paired before to have an affect.
 */
void coap_client_toggle_one_light(void);

/** @brief Toggle lights on all CoAP servers in the network mesh.
 */
void coap_client_toggle_mesh_lights(void);

/** @brief Request for the CoAP server address to pair.
 *
 * @note Enable paring on the CoAP server to get the address.
 */
void coap_client_send_provisioning_request(void);

/** @brief Toggle SED to MED and MED to SED modes.
 *
 * @note Active when the device is working as Minimal Thread Device.
 */
void coap_client_toggle_minimal_sleepy_end_device(void);

#endif

/**
 * @}
 */
```

## include/coap_server_client_interface.h
```c
/*
 * Copyright (c) 2020 Nordic Semiconductor ASA
 *
 * SPDX-License-Identifier: LicenseRef-Nordic-5-Clause
 */

#ifndef __COAP_SERVER_CLIENT_INTRFACE_H__
#define __COAP_SERVER_CLIENT_INTRFACE_H__

#define COAP_PORT 5683

/**@brief Enumeration describing light commands. */
enum light_command {
	THREAD_COAP_UTILS_LIGHT_CMD_OFF = '0',
	THREAD_COAP_UTILS_LIGHT_CMD_ON = '1',
	THREAD_COAP_UTILS_LIGHT_CMD_TOGGLE = '2'
};

#define PROVISIONING_URI_PATH "provisioning"
#define SENSOR_URI_PATH "sensor"

#endif
```

## include/fsm_mesh.h
```c
#ifndef FSM_MESH_H
#define FSM_MESH_H

#include "fsm.h"



fsm_t* fsm_new_fsm_mesh(fsm_t* fsm_p);


#endif
```

## include/fsm_protocol_controller.h
```c
#ifndef FSM_PROTOCOL_CONTROLLER_H
#define FSM_PROTOCOL_CONTROLLER_H

#include "fsm.h"
#include <stdint.h>


struct p_fsm_t;
typedef struct p_fsm_t p_fsm_t;


fsm_t* fsm_new_fsm_protocol_controller(uint32_t Tprotocol);
void set_flag_mesh (fsm_t* this);
void clear_flag_mesh (fsm_t* this);
int get_flag_mesh (fsm_t* this);
void set_flag_thread (fsm_t* this);
void clear_flag_thread (fsm_t* this);
int get_flag_thread (fsm_t* this);


#endif
```

## include/fsm_thread.h
```c
#ifndef FSM_THREAD_H
#define FSM_THREAD_H

#include "fsm.h"

fsm_t* fsm_new_fsm_thread(fsm_t* fsm_p);

#endif
```

## include/hts221.h
```c
#ifndef HTS221_H
#define HTS221_H

#include "hts221_defines.h"
#include <zephyr/kernel.h>
#include "nrfx_config.h"
#include "nrfx_twi.h"
#include <drivers/include/nrfx_twi.h>
typedef struct hts221_t hts221_t;
typedef float hts221_value_t;

typedef void(* hts221_cb_t)(
	hts221_t* self, hts221_value_t temp, hts221_value_t humd);

typedef struct hts221_conf_t {
	hts221_conf_frec_t   frec;
	hts221_conf_avtemp_t avtemp;
	hts221_conf_avhumd_t avhumd;
	hts221_cb_t          cb;
	uint8_t              drdy_pin;
	uint16_t             timeout;
} hts221_conf_t;

typedef struct hts221_calib_t {
	float slope;
	float orig;
} hts221_calib_t;

struct hts221_t {
	const nrfx_twi_t* twi;
	hts221_cb_t       cb;
	uint8_t           drdy_pin;
	hts221_calib_t    tCalib;
	hts221_calib_t    hCalib;
};

nrfx_err_t hts221_init(
	hts221_t* self,
	const nrfx_twi_t* twi,
	hts221_conf_t* conf);
nrfx_err_t hts221_read(
	hts221_t* self,
	hts221_value_t* temp,
	hts221_value_t* humd);



#endif // HTS221_H
```

## include/hts221_defines.h
```c
#ifndef HTS221_DEFINES_H
#define HTS221_DEFINES_H

#include "iris_boardv1.h"

/** Address */
#define HTS221_ADDR          0xBEU
#define HTS221_ADDR_7BITS    (HTS221_ADDR >> 1)

/** Registers */
#define HTS221_REG_WHO       0x0FU
#define HTS221_REG_CONF      0x10U
#define HTS221_REG_CTRL1     0x20U
#define HTS221_REG_CTRL2     0x21U
#define HTS221_REG_CTRL3     0x22U
#define HTS221_REG_STATUS    0x27U
#define HTS221_REG_HUM_H     0x29U
#define HTS221_REG_HUM_L     0x28U
#define HTS221_REG_TEMP_H    0x2BU
#define HTS221_REG_TEMP_L    0x2AU
/** Calibrtion */
#define HTS221_REG_H0_RH     0x30U
#define HTS221_REG_H1_RH     0x31U
#define HTS221_REG_T0_DEG    0x32U
#define HTS221_REG_T1_DEG    0x33U
#define HTS221_REG_T_MSB     0x35U
#define HTS221_REG_H0_OUT_H  0x37U
#define HTS221_REG_H0_OUT_L  0x36U
#define HTS221_REG_H1_OUT_H  0x3BU
#define HTS221_REG_H1_OUT_L  0x3AU
#define HTS221_REG_T0_OUT_H  0x3DU
#define HTS221_REG_T0_OUT_L  0x3CU
#define HTS221_REG_T1_OUT_H  0x3FU
#define HTS221_REG_T1_OUT_L  0x3EU

/** Bits */
// AV_CONF
#define HTS221_BIT_AVGT2     (1 << 5)
#define HTS221_BIT_AVGT1     (1 << 4)
#define HTS221_BIT_AVGT0     (1 << 3)
#define HTS221_POS_AVGT      3
#define HTS221_BIT_AVGH2     (1 << 2)
#define HTS221_BIT_AVGH1     (1 << 1)
#define HTS221_BIT_AVGH0     (1 << 0)
#define HTS221_POS_AVGH      0
// CTRL_REG1
#define HTS221_BIT_PD        (1 << 7)
#define HTS221_BIT_BDU       (1 << 2)
#define HTS221_BIT_ODR1      (1 << 1)
#define HTS221_BIT_ODR0      (1 << 0)
#define HTS221_POS_ODR       0
// CTRL_REG2
#define HTS221_BIT_BOOT      (1 << 7)
#define HTS221_BIT_HEATER    (1 << 1)
#define HTS221_BIT_ONE_SHOT  (1 << 0)
// CTRL_REG3
#define HTS221_BIT_DRDY_H_L  (1 << 7)
#define HTS221_BIT_PP_OD     (1 << 6)
#define HTS221_BIT_DRDY      (1 << 2)
// STATUS_REG
#define HTS221_BIT_H_DA      (1 << 1)
#define HTS221_BIT_T_DA      (1 << 0)
// Calibration
#define HTS221_POS_T0_MSB    0
#define HTS221_POS_T1_MSB    2
#define HTS221_MASK_T0_MSB   0x03U
#define HTS221_MASK_T1_MSB   0x0CU

typedef enum {
	HTS221_FREC_ONE_SHOT = 0b00U,
	HTS221_FREC_1HZ      = 0b01U,
	HTS221_FREC_7HZ      = 0b10U,
	HTS221_FREC_12HZ5    = 0b11U
} hts221_conf_frec_t;

typedef enum {
	HTS221_AVTEMP_2   = 0b000U,
	HTS221_AVTEMP_4   = 0b001U,
	HTS221_AVTEMP_8   = 0b010U,
	HTS221_AVTEMP_16  = 0b011U,
	HTS221_AVTEMP_32  = 0b100U,
	HTS221_AVTEMP_64  = 0b101U,
	HTS221_AVTEMP_128 = 0b110U,
	HTS221_AVTEMP_256 = 0b111U
} hts221_conf_avtemp_t;

typedef enum {
	HTS221_AVHUMD_4   = 0b000U,
	HTS221_AVHUMD_8   = 0b001U,
	HTS221_AVHUMD_16  = 0b010U,
	HTS221_AVHUMD_32  = 0b011U,
	HTS221_AVHUMD_64  = 0b100U,
	HTS221_AVHUMD_128 = 0b101U,
	HTS221_AVHUMD_256 = 0b110U,
	HTS221_AVHUMD_512 = 0b111U
} hts221_conf_avhumd_t;

#define HTS221_WHO 0xBCU

#endif // HTS221__DEFINES_H
```

## include/iris_boardv1.h
```c
#ifndef IRIS_BOARD1_H
#define IRIS_BOARD1_H

#ifdef __cplusplus
extern "C" {
#endif

#include <hal/nrf_gpio.h>

/**GENERIC**/
#define PIN_SDA    19
#define PIN_SCL    13
#define PIN_NFC1   9
#define PIN_NFC2   10
#define PIN_NRESET 18
#define PIN_2      2
#define PIN_4      4
#define PIN_6      6
#define PIN_8      8

/*BUTTONS*/
#define BUTTONS_NUMBER       0
#define BUTTONS_LIST         {}
#define BUTTONS_ACTIVE_STATE 0
#define BUTTON_PULL          NRF_GPIO_PIN_PULLUP

/*LEDS*/
#define LEDS_NUMBER       3
#define LED_1             4
#define LED_2             27
#define LED_3             26
#define LED_RED           LED_1
#define LED_GREEN         LED_2
#define LED_BLUE          LED_3
#define LEDS_LIST         {LED_RED, LED_GREEN, LED_BLUE}
#define LEDS_ACTIVE_STATE 0

/**FXOS8700CQ**/
/**wrong?**/
#define FXOS8700CQ_PRESENT  1
#define PIN_INT1_FXOS8700CQ 25
#define PIN_INT2_FXOS8700CQ 24
#define PIN_RST_FXOS8700CQ  23

/**LPS25HBTR**/
#define LPS25HBTR_PRESENT     1
#define PIN_INT_DRD_LPS25HBTR 13

/**HTS221**/
#define HTS221_PRESENT  1
#define PIN_DRDY_HTS221 8

#ifdef __cplusplus
}
#endif

#endif // IRIS_BOARD1_H
```

## include/main.h
```c
#ifndef MAIN_H
#define MAIN_H

void bt_ready(int err);

#endif
```

## include/model_handler.h
```c
/*
 * Copyright (c) 2020 Nordic Semiconductor ASA
 *
 * SPDX-License-Identifier: LicenseRef-Nordic-5-Clause
 */

/**
 * @file
 * @brief Model handler
 */

#ifndef MODEL_HANDLER_H__
#define MODEL_HANDLER_H__

#include <zephyr/bluetooth/mesh.h>

#ifdef __cplusplus
extern "C" {
#endif

const struct bt_mesh_comp *model_handler_init(void);
int send_data(void);
//void bt_ready(int err);
#ifdef __cplusplus
}
#endif

#endif /* MODEL_HANDLER_H__ */
```

## src/coap_client.c
```c
/*
 * Copyright (c) 2020 Nordic Semiconductor ASA
 *
 * SPDX-License-Identifier: LicenseRef-Nordic-5-Clause
 */

#include <zephyr/kernel.h>
#include <dk_buttons_and_leds.h>
#include <zephyr/logging/log.h>
#include <ram_pwrdn.h>
#include <zephyr/device.h>
#include <zephyr/drivers/counter.h>
#include <zephyr/pm/device.h>
#include <zephyr/net/coap.h>
#include "../include/coap_client_utils.h"
#include <time.h>
#include <zephyr/sys/timeutil.h>
#include <zephyr/dt-bindings/clock/ast10x0_clock.h>
#include <zephyr/drivers/gpio.h>
#include "../include/coap_server_client_interface.h"
#include "../include/coap_client.h"


/*
#include "nrfx_twi.h"
#include "../include/hts221.h"
#include <zephyr/drivers/i2c.h>
*/


#define ID_SENSOR 4 //cambiar para cada sensor
#define	PERIOD_SEND_MS	5000
 
#define LED0_NODE DT_ALIAS(led0)

//#define I2C0_NODE DT_NODELABEL(mysensor)
//static const struct i2c_dt_spec dev_i2c = I2C_DT_SPEC_GET(I2C0_NODE);
static const struct gpio_dt_spec led = GPIO_DT_SPEC_GET(LED0_NODE, gpios);
/*
static hts221_t m_hts;
nrfx_twi_t m_twi;

static void twi_init(void);
static nrfx_err_t hts_init(void);
*/
//DIRECCIÓN MULTICAST
static struct sockaddr_in6 send_local_addr = {
	.sin6_family = AF_INET6,
	.sin6_port = htons(COAP_PORT),

	
	.sin6_addr.s6_addr = { 0xff, 0x03, 0x00, 0x00, 0x00, 0x00, 0x00, 0x00,
			       0x00, 0x00, 0x00, 0x00, 0x00, 0x00, 0x00, 0x01 },
	.sin6_scope_id = 0U
};

//DIRECCIÓN UNICAST, VA CAMBIANDO MLEID
/*static struct sockaddr_in6 send_local_addr = {
	.sin6_family = AF_INET6,
	.sin6_port = htons(COAP_PORT),

	//fe80::215:5dff:fee2:25a5

	.sin6_addr.s6_addr = { 0xfe, 0x80, 0x00, 0x00, 0x00, 0x00, 0x00, 0x00,
			       0x02, 0x15, 0x5d, 0xff, 0xfe, 0xe2, 0x25, 0xa5 },
	.sin6_scope_id = 0U
};*/

static const char *const sensor_option[] = { SENSOR_URI_PATH, NULL };

//-----------------------

//para poder sacar LOGS
LOG_MODULE_REGISTER(coap_client);

#define OT_CONNECTION_LED DK_LED1
#define BLE_CONNECTION_LED DK_LED2
#define MTD_SED_LED DK_LED3

/*static void twi_init(void)
{

	const nrfx_twi_config_t twi_config = {
		.scl = nrf_twi_scl_pin_get(&dev_i2c),
		.sda =  nrf_twi_sda_pin_get(&dev_i2c),
		.frequency = NRF_TWI_FREQ_100K,
		.interrupt_priority = NRFX_TWI_DEFAULT_CONFIG_IRQ_PRIORITY,
		.hold_bus_uninit = false
	};
	// If a twi handler is not provided, the driver setup in blocking mode
	(nrfx_twi_init(&m_twi, &twi_config, NULL, NULL));
	nrfx_twi_enable(&m_twi);
	LOG_INF("TWI enable");
}
void get_data(uint8_t *buffer){
	hts221_value_t humd;
	hts221_value_t temp;
	(hts221_read(&m_hts, &temp, &humd));
	
		
    memset(buffer, 0, sizeof(buffer));
	snprintf(buffer, sizeof(buffer),"ID:%d,t:%d,h:%d,p:%d\n",ID_SENSOR, temp, humd);

	

}

static nrfx_err_t hts_init(void)
{
	hts221_conf_t hts_conf = {
		.frec     = HTS221_FREC_ONE_SHOT,
		.avtemp   = HTS221_AVTEMP_128,
		.avhumd   = HTS221_AVHUMD_128,
		.cb       = NULL,
		.drdy_pin = PIN_DRDY_HTS221,
		.timeout  = 0,
	};

	(hts221_init(&m_hts, &m_twi, &hts_conf));
	LOG_INF("HTS init");
}
*/

/** @brief Checks if ot node is provisioned by checking the role
 */
bool thread_is_provisioned(otInstance *instance){
	otDeviceRole role = otThreadGetDeviceRole(instance);
	LOG_INF("ROL:%d", role);
	return (role == OT_DEVICE_ROLE_CHILD ||
            role == OT_DEVICE_ROLE_ROUTER ||
            role == OT_DEVICE_ROLE_LEADER);
			
}

int get_temp(void){

	int temp[5] = {17, 18, 19, 20, 21};
	return temp[rand() % 5];
}

int get_hum(void){
	int hum[5] = {55, 56, 57, 58, 59};
	return hum[rand() % 5];
}
int get_data(void){
	int temp;
	int hum;
	char buffer[50];
	int err;
	if (IS_ENABLED(CONFIG_RAM_POWER_DOWN_LIBRARY)) {
		power_down_unused_ram();
	}
	temp = get_temp();
	hum = get_hum();
	memset(buffer, 0, sizeof(buffer));
	
	snprintf(buffer, sizeof(buffer),"ID:%d,t:%d,h:%d\n",ID_SENSOR, temp, hum);
	LOG_INF(" %s\n",buffer);
	//medir latencia
	//gpio_pin_set(led.port,led.pin,1);
	//funcion que envia datos
	err = coap_send_request(COAP_METHOD_PUT,
			  (const struct sockaddr *)&send_local_addr,
			  sensor_option, buffer,sizeof(buffer), NULL);
			  LOG_INF("Error: %d", err);
	//gpio_pin_set(led.port,led.pin,0);
	//k_sleep(K_MSEC(PERIOD_SEND_MS));

	return 0;
}
```
